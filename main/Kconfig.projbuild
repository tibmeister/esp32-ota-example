## main/Kconfig.projbuild
```kconfig
menu "WiFi Settings"
config ESP_WIFI_SSID
    string "WiFi STA SSID"
    default ""
    help
    WiFi SSID (network name) to connect to or empty for Off.

config ESP_WIFI_PASSWORD
    string "WiFi STA Password"
    default ""
    help
    WiFi Password if WEP/WPA/WPA2 or empty if Open.

config ESP_MAXIMUM_RETRY
    int "Maximum retry"
    default 5
    help
    Set the Maximum retry to avoid station reconnecting to the AP unlimited when the AP is really inexistent.

config ESP_WIFI_AP_SSID
    string "WiFi AP SSID"
    default "ESP32"
    help
	AP SSID (network name) to create or empty for Off.

config ESP_WIFI_AP_PASSWORD
    string "WiFi AP Password"
    default "987654321"
    help
	AP password for WPA2 or empty for Open.

config SERVER_IP
    string "WiFi AP IP Address"
    default "192.168.4.1"
    help
    IP address that the ESP will assign to it's AP interface. You can use this IP to connect to the board after flashing.

config LWIP_LOCAL_HOSTNAME
    string "Local hostname"
    default "espressif"
    help
    The hostname under which the board will accesible in the local network.

endmenu

menu "OTA Configuration"

    config FIRMWARE_UPGRADE_URL
        string "Firmware Upgrade URL"
        default ""
        help
            URL of server which hosts the firmware image.

    config FIRMWARE_UPGRADE_URL_FROM_STDIN
        bool
        default y if EXAMPLE_FIRMWARE_UPGRADE_URL = "FROM_STDIN"

    config SKIP_COMMON_NAME_CHECK
        bool "Skip server certificate CN fieldcheck"
        default n
        help
            This allows you to skip the validation of OTA server certificate CN field.

    config SKIP_VERSION_CHECK
        bool "Skip firmware version check"
        default n
        help
            This allows you to skip the firmware version check.

    config OTA_RECV_TIMEOUT
        int "OTA Receive Timeout"
        default 5000
        help
            Maximum time for reception

endmenu

menu "Font Configuration"

config STORE_FONT_PARTITION
    bool "Store Font Partition"
    default n
    help
    Set to True to erase and rewrite the font partition. This causes all selected fonts to be loaded into memory and written out to a partition. This option is meant for exporting a font partition image containing specific fonts.

endmenu
```
